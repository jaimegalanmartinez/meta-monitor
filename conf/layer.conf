## conf/layer.conf
```bitbake
# meta-monitor layer
BBPATH .= ":${LAYERDIR}"
BBFILES += "${LAYERDIR}/recipes-*/*/*.bb \
            ${LAYERDIR}/recipes-*/*/*.bbappend"

BBFILE_COLLECTIONS += "monitor"
BBFILE_PATTERN_monitor = "^${LAYERDIR}/"
BBFILE_PRIORITY_monitor = "10"

LAYERSERIES_COMPAT_monitor = "scarthgap"
LAYERDEPENDS_monitor = "core"
LAYERVERSION_monitor = "1"
```
